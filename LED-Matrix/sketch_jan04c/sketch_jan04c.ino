char ground[8] = {9,8,7,6,5,4,3,2};
char p[8]={10,11,12,13,A2,A3,A4,A5};

char ALPHA[] = {0,0,0,0,0,0,0,0,0,0,0,
60,102,96,96,96,102,60,0,0,0,
60,24,24,24,24,24,60,0,0,0,
124,102,102,124,120,108,102,0,0,0,
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0,0,0,0,0,0,0,0,0,0,0
};
void setup() 
{
  for (int x=2;x<=9;x++)
  {
    pinMode(x, OUTPUT);
  }
  for (int x=0;x<8;x++)
  {
    pinMode(p[x], OUTPUT);
    digitalWrite(p[x],HIGH);
  }
  for (int i=0;i<8;i++)
  {
    digitalWrite(ground[i],HIGH);
  }
  DDRD = 0xFF;
  PORTD =0;
}

void loop() 
{
  for(int x=0;x<142;x++)
  {
    for(int a=0;a<20;a++)
    {
         for (int i=0;i<8;i++)
          { 
             digitalWrite(ground[i],LOW);
             PORTD = ALPHA[i+x];
            delay(1);
            digitalWrite(ground[i],HIGH);
          }    
    }
  }
  delay(1000);
}
